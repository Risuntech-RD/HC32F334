# HC32F334KATI register map
File version: 1.0
CPU: CM4 r0p1, little endian, MPU, FPU, 4 interrupt priority bits
Registers are 32-bit, read-write, reset 0x0 unless marked. A register's access mark holds for its fields unless they carry their own. Offsets are from the block's base; lines under a group give offsets from that group; [hi:lo] are bit positions; {n}, {i} and the like mark numbered series; 'fields as' and 'values as' point back to an identical list; <NAME> marks a mode.

## Memory map
0x00000400 ICG size 0x10
0x40008C00 CRC size 0x100
0x40010400 EFM size 0x194
0x40010800 AOS size 0x174
0x4001C000 SPI size 0x1C
0x4001CC00 USART1 size 0x1C
0x4001D000 USART2 size 0x20 — desc USART
0x4001D400 USART3 size 0x20 — desc USART
0x4001D800 USART4 size 0x20 — desc USART
0x40024000 TMR01 size 0x18 — desc TMR0
0x40024400 TMR02 size 0x18 — desc TMR0
0x40026000 TMRA5 size 0x14E — desc TMRA
0x40038000 TMR4 size 0xFE
0x40038400 CMP1 size 0x20 — desc CMP
0x40038500 CMP2 size 0x20 — desc CMP
{0x40038600+0x20*n} EMB{n} size 0x1C (n=0..8) — desc EMB
0x40039000 TMR61 size 0x1A0 — desc TMR6
0x40039300 TMR6_COMMON size 0x100
0x40039400 TMR62 size 0x1A0 — desc TMR6
0x40039800 TMR63 size 0x1A0 — desc TMR6
0x40039C00 TMR64 size 0x1A0 — desc TMR6
0x4003A000 TMRA1 size 0x14E
0x4003A400 TMRA2 size 0x14E — desc TMRA
0x4003A800 TMRA3 size 0x14E — desc TMRA
0x4003AC00 TMRA4 size 0x14E — desc TMRA
0x4003B000 CMP3 size 0x20 — desc CMP
0x4003B400 I2C size 0x3C
0x4003C000 HRPWM1 size 0x2DC
0x4003C2F0 HRPWM_COMMON size 0x110
0x4003C400 HRPWM2 size 0x2A8 — desc HRPWM
0x4003C800 HRPWM3 size 0x2A8 — desc HRPWM
0x4003CC00 HRPWM4 size 0x2A8 — desc HRPWM
0x4003D000 HRPWM5 size 0x2A8 — desc HRPWM
0x4003D400 HRPWM6 size 0x2A8 — desc HRPWM
0x40040000 ADC1 size 0xB1
0x40040400 ADC2 size 0xB1
0x40040800 ADC3 size 0xB1
0x40041000 DAC1 size 0x30 — desc DAC
0x40041400 DAC2 size 0x30 — desc DAC
0x40048000 CMU size 0xC104
0x40048000 PWC size 0xC400
0x40048400 FCM size 0x24
0x40049000 WDT size 0xC
0x40049400 SWDT size 0xC
0x40049C00 CTC size 0xE
0x4004C000 RTC size 0x5D
0x4004CCE0 RMU size 0x18
0x4004FC00 PLA size 0xD0
0x40050000 MPU size 0x70
0x40050800 SRAMC size 0x74
0x40051000 INTC size 0x2AC
0x40053000 DMA size 0x238
0x40053800 GPIO size 0x54C
0x40055400 PERIC size 0x20
0x40071000 MCAN1 size 0xFC — desc MCAN
0x40071400 MCAN2 size 0xFC — desc MCAN
0x40073800 MCANRAM size 0x18
0xE0042000 DBGC size 0x2C

## Interrupts
{n} GLOBAL{n}_SWINT{n} (INTC) (n=0..15) — global interrupt {n} or software interrupt {n}
{n} GLOBAL{n}_EXINT{n-16} (INTC) (n=16..31) — global interrupt {n} or external interrupt {n-16}
32 DMA_Error (DMA) — DMA error interrupt
{n+33} DMA_TC{n}_BTC{n} (DMA) (n=0..7) — DMA Transmission Complete {n} or Block Transmission Complete {n} interrupt
41 PEERR_RDCOL (EFM) — EFM Program Erase error or Read Column interrupt
42 OPEND (EFM) — EFM Operation End interrupt
43 FPU_ERR (INTC) — FPU error interrupt
44 TMR0_1 (TMR01) — Timer0 unit 1 interrupt
45 TMR0_2 (TMR02) — Timer0 unit 2 interrupt
46 RTC — RTC interrupt
47 XTAL_STOP (CMU) — Xtal stop interrupt
48 WKTM (PWC) — WKTM compare matched interrupt
49 SWDT — SWDT underflow or update error interrupt
50 TMR6_1_GCMP (TMR61) — Timer6 unit 1 compare matched interrupt
51 TMR6_1_OVF_UDF (TMR61) — Timer6 unit 1 overflow or underflow interrupt
52 TMR6_1_DTE (TMR61) — Timer6 unit 1 dead time error interrupt
53 TMR6_1_SCMP (TMR61) — Timer6 unit 1 special compare matched interrupt
54 TMRA_1_OVF_UDF (TMRA1) — TimerA unit 1 overflow or underflow interrupt
55 TMRA_1_CMP (TMRA1) — TimerA unit 1 compare matched interrupt
56 TMR6_2_GCMP (TMR62) — Timer 6 unit 2 compare matched interrupt
57 TMR6_2_OVF_UDF (TMR62) — Timer 6 unit 2 overflow or underflow interrupt
58 TMR6_2_DTE (TMR62) — Timer 6 unit 2 dead time error interrupt
59 TMR6_2_SCMP (TMR62) — Timer 6 unit 2 special compare matched interrupt
60 TMRA_2_OVF_UDF (TMRA2) — TimerA unit 2 overflow or underflow interrupt
61 TMRA_2_CMP (TMRA2) — TimerA unit 2 compare matched interrupt
62 TMR6_3_GCMP (TMR63) — TMR6 unit 3 compare matched interrupt
63 TMR6_3_OVF_UDF (TMR63) — TMR6 unit 3 overflow or underflow interrupt
64 TMR6_3_DTE (TMR63) — TMR6 unit 3 dead time error interrupt
65 TMR6_3_SCMP (TMR63) — TMR6 unit 3 special compare matched interrupt
66 TMRA_3_OVF_UDF (TMRA3) — TimerA unit 3 overflow or underflow interrupt
67 TMRA_3_CMP (TMRA3) — TimerA unit 3 compare matched interrupt
68 TMR6_4_GCMP (TMR64) — TMR6 unit 4 compare matched interrupt
69 TMR6_4_OVF_UDF (TMR64) — TMR6 unit 4 overflow or underflow interrupt
70 TMR6_4_DTE (TMR64) — TMR6 unit 4 dead time error interrupt
71 TMR6_4_SCMP (TMR64) — TMR6 unit 4 special compare matched interrupt
72 TMRA_4_OVF_UDF (TMRA4) — TimerA unit 4 overflow or underflow interrupt
73 TMRA_4_CMP (TMRA4) — TimerA unit 4 compare matched interrupt
74 HRPWM1_GCMP (HRPWM1) — HRPWM unit 1 compare matched interrupt
75 HRPWM1_OVF_UDF (HRPWM1) — HRPWM unit 1 overflow or underflow interrupt
76 HRPWM1_SCM (HRPWM1) — HRPWM unit 1 spacail compare interrupt
77 HRPWM1_GCAP (HRPWM1) — HRPWM unit 1 capture interrupt
78 HRPWM2_GCMP (HRPWM2) — HRPWM unit 2 compare matched interrupt
79 HRPWM2_OVF_UDF (HRPWM2) — HRPWM unit 2 overflow or underflow interrupt
80 HRPWM2_SCM (HRPWM2) — HRPWM unit 2 spacail compare interrupt
81 HRPWM2_GCAP (HRPWM2) — HRPWM unit 2 capture interrupt
82 HRPWM_IRQ (HRPWM1) — HRPWM BM overflow or Calculate end or Delay interrupt or External event detect interrupt
83 EMB_GR0 (EMB0) — EMB Group0 interrupt
84 EMB_GR1 (EMB1) — EMB Group1 interrupt
85 EMB_GR2 (EMB2) — EMB Group2 interrupt
86 EMB_GR3 (EMB3) — EMB Group3 interrupt
87 HRPWM3_GCMP (HRPWM3) — HRPWM unit 3 compare matched interrupt
88 HRPWM3_OVF_UDF (HRPWM3) — HRPWM unit 3 overflow or underflow interrupt
89 HRPWM3_SCM (HRPWM3) — HRPWM unit 3 spacail compare interrupt
90 HRPWM3_GCAP (HRPWM3) — HRPWM unit 3 capture interrupt
91 HRPWM4_GCMP (HRPWM4) — HRPWM unit 4 compare matched interrupt
92 HRPWM4_OVF_UDF (HRPWM4) — HRPWM unit 4 overflow or underflow interrupt
93 HRPWM4_SCM (HRPWM4) — HRPWM unit 4 spacail compare interrupt
94 HRPWM4_GCAP (HRPWM4) — HRPWM unit 4 capture interrupt
95 EMB_GR4 (EMB4) — EMB Group4 interrupt
96 EMB_GR5 (EMB5) — EMB Group5 interrupt
97 EMB_GR6 (EMB6) — EMB Group6 interrupt
98 EMB_GR7 (EMB7) — EMB Group7 interrupt
99 EMB_GR8 (EMB8) — EMB Group8 interrupt
100 HRPWM5_GCMP (HRPWM5) — HRPWM unit 5 compare matched interrupt
101 HRPWM5_OVF_UDF (HRPWM5) — HRPWM unit 5 overflow or underflow interrupt
102 HRPWM5_SCM (HRPWM5) — HRPWM unit 5 spacail compare interrupt
103 HRPWM5_GCAP (HRPWM5) — HRPWM unit 5 capture interrupt
104 HRPWM6_GCMP (HRPWM6) — HRPWM unit 6 compare matched interrupt
105 HRPWM6_OVF_UDF (HRPWM6) — HRPWM unit 6 overflow or underflow interrupt
106 HRPWM6_SCM (HRPWM6) — HRPWM unit 6 spacail compare interrupt
107 HRPWM6_GCAP (HRPWM6) — HRPWM unit 6 capture interrupt
108 CANRAM_ECCER (MCANRAM) — CAN RAM ECC check error interrupt
109 CAN1_INT0 (MCAN1) — CAN1 interrupt0
109 CAN2_INT0 (MCAN2) — CAN2 interrupt0
110 CAN1_INT1 (MCAN1) — CAN1 interrupt1
110 CAN2_INT1 (MCAN2) — CAN2 interrupt1
113 GCMP (TMR4) — Timer4 unit 1 compare matched interrupt
114 OVF_UDF (TMR4) — Timer4 unit 1 overflow or underflow interrupt
115 RELOAD (TMR4) — Timer4 unit 1 reload matched interrupt
116 SCM (TMR4) — Timer4 unit 1 special compare matched interrupt
117 CMP1 — CMP1 interrupt
118 CMP2 — CMP2 interrupt
119 CMP3 — CMP3 interrupt
120 I2C — I2C interrupt
121 USART1 — USART unit 1 interrupt
122 USART1_TC (USART1) — USART unit 1 Transmission complete interrupt
123 SPI — SPI interrupt
124 TMRA_5_OVF_UDF (TMRA5) — TimerA unit 5 overflow or underflow interrupt
125 TMRA_5_CMP (TMRA5) — TimerA unit 5 compare matched interrupt
126 EVENT_PORT1 (GPIO) — event port 1 interrupt
127 EVENT_PORT2 (GPIO) — event port 2 interrupt
128 EVENT_PORT3 (GPIO) — event port 3 interrupt
129 EVENT_PORT4 (GPIO) — event port 4 interrupt
130 USART2 — USART unit 2 interrupt
131 USART2_TC (USART2) — USART unit 2 Transmission complete interrupt
132 USART3 — USART unit 3 interrupt
133 USART3_TC (USART3) — USART unit 3 Transmission complete interrupt
134 USART4 — USART unit 4 interrupt
135 USART4_TC (USART4) — USART unit 4 Transmission complete interrupt
136 PLAINT (PLA) — PLA interrupt
137 USART1_WKUP (USART1) — USART unit 1 weak-up interrupt
138 PVD1 (PWC) — Programable voltage detect unit 1 interrupt
139 PVD2 (PWC) — Programable voltage detect unit 2 interrupt
140 FCM — Frequency measurement interrupt
141 WDT — WDT underflow or update error interrupt
142 CTC — CTC error interrupt
143 ADC1 — ADC unit 1 interrupt
144 ADC2 — ADC unit 2 interrupt
145 ADC3 — ADC unit 3 interrupt
